## drivers/dca/Kconfig
```kconfig
#
# DCA server configuration
#

config DCA
	tristate
	depends on DMA_ENGINE_V3 && PCI
	default m
	---help---
	  This is a server to help modules that want to use Direct Cache
	  Access to find DCA providers that will supply correct CPU tags.
```

## drivers/dma_v3/Kconfig
```kconfig
#
# DMA engine configuration
#

menu "DMA Engine support version 3"

config DMA_ENGINE_V3
	bool "Support for DMA engines version 3"
	---help---
	   DMA engines offload copy operations from the CPU to dedicated
	   hardware, allowing the copies to happen asynchronously.

comment "DMA Clients V3"

config NET_DMA
	bool "Network: TCP receive copy offload"
	depends on DMA_ENGINE_V3 && NET
	default y
	---help---
	 This enables the use of DMA engines in the network stack to
	 offload receive copy-to-user operations, freeing CPU cycles.
	 Since this is the main user of the DMA engine, it should be enabled;
	 say Y here.

comment "DMA Devices"

config INTEL_IOATDMA_V3
	tristate "Intel I/OAT DMA support version 3"
	depends on DMA_ENGINE_V3 && PCI
	default m
	---help---
	  Enable version 3 support for the Intel(R) I/OAT DMA engine.

endmenu
```

## drivers/infiniband/ulp/vnic/Kconfig
```kconfig
config INFINIBAND_VNIC
	tristate "VNIC - Support for QLogic Virtual Ethernet I/O Controller"
	depends on INFINIBAND && NETDEVICES && INET
	---help---
	  Support for the QLogic Virtual Ethernet I/O Controller
	  (VEx). In conjunction with the VEx, this provides virtual
	  ethernet interfaces and transports ethernet packets over
	  InfiniBand so that you can communicate with Ethernet networks
	  using your IB device.

config INFINIBAND_VNIC_DEBUG
	bool "VNIC Verbose debugging"
	depends on INFINIBAND_VNIC
	default n
	---help---
	  This option causes verbose debugging code to be compiled
	  into the VNIC driver.  The output can be turned on via the
	  vnic_debug module parameter.

config INFINIBAND_VNIC_STATS
	bool "VNIC Statistics"
	depends on INFINIBAND_VNIC
	default n
	---help---
	  This option compiles statistics collecting code into the
	  data path of the VNIC driver to help in profiling and fine
	  tuning. This adds some overhead in the interest of gathering
	  data.
```

## drivers/misc/Kconfig
```kconfig
#
# Misc strange devices
#

menu "Misc devices"

config IBM_ASM
	tristate "Device driver for IBM RSA service processor"
	depends on X86 && PCI && EXPERIMENTAL
	---help---
	  This option enables device driver support for in-band access to the
	  IBM RSA (Condor) service processor in eServer xSeries systems.
	  The ibmasm device driver allows user space application to access
	  ASM (Advanced Systems Management) functions on the service
	  processor. The driver is meant to be used in conjunction with
	  a user space API.
	  The ibmasm driver also enables the OS to use the UART on the
	  service processor board as a regular serial port. To make use of
	  this feature serial driver support (CONFIG_SERIAL_8250) must be
	  enabled.
	  
	  WARNING: This software may not be supported or function
	  correctly on your IBM server. Please consult the IBM ServerProven
	  website <http://www.pc.ibm.com/ww/eserver/xseries/serverproven> for
	  information on the specific driver level and support statement
	  for your IBM server.


	  If unsure, say N.

config EEPROM_93CX6
	tristate "EEPROM 93CX6 support"
	---help---
	  This is a driver for the EEPROM chipsets 93c46 and 93c66.
	  The driver supports both read as well as write commands.

	  If unsure, say N.

config HP_ILO
        tristate "Channel interface driver for HP iLO/iLO2 processor"
        depends on PCI
        default n
        help
          The channel interface driver allows applications to communicate
          with iLO/iLO2 management processors present on HP ProLiant
          servers.  Upon loading, the driver creates /dev/hpilo/dXccbN files,
          which can be used to gather data from the management processor,
          via read and write system calls.

          To compile this driver as a module, choose M here: the
          module will be called hpilo.

config ENCLOSURE_SERVICES
	tristate "Enclosure Services"
	default n
	help
	  Provides support for intelligent enclosures (bays which
	  contain storage devices).  You also need either a host
	  driver (SCSI/ATA) which supports enclosures
	  or a SCSI enclosure device (SES) to use these services.

endmenu
```

## drivers/scsi/cxgbi/cxgb3i/Kconfig
```kconfig
config SCSI_CXGB3_ISCSI
	tristate "Chelsio T3 iSCSI support"
	select CHELSIO_T3
	select SCSI_ISCSI2_ATTRS
	---help---
	  This driver supports iSCSI offload for the Chelsio T3 devices.
```

## drivers/scsi/device_handler/Kconfig
```kconfig
#
# SCSI Device Handler configuration
#

menuconfig SCSI_DH
	tristate "SCSI Device Handlers"
	depends on SCSI
	default n
	help
	  SCSI Device Handlers provide device specific support for
	  devices utilized in multipath configurations. Say Y here to
	  select support for specific hardware.

config SCSI_DH_EMC
	tristate "EMC CLARiiON Device Handler"
	depends on SCSI_DH
	help
	If you have a EMC CLARiiON select y. Otherwise, say N.

config SCSI_DH_RDAC
	tristate "LSI RDAC Device Handler"
	depends on SCSI_DH
	help
	If you have a LSI RDAC select y. Otherwise, say N.

config SCSI_DH_ALUA
	tristate "SPC-3 ALUA Device Handler (EXPERIMENTAL)"
	depends on SCSI_DH && EXPERIMENTAL
	help
	SCSI Device handler for generic SPC-3 Asymmetric Logical Unit
	Access (ALUA).
```

## drivers/uio/Kconfig
```kconfig
menuconfig UIO
	tristate "Userspace I/O drivers"
	depends on !S390
	default n
	help
	  Enable this to allow the userspace driver core code to be
	  built.  This code allows userspace programs easy access to
	  kernel interrupts and memory locations, allowing some drivers
	  to be written in userspace.  Note that a small kernel driver
	  is also required for interrupt handling to work properly.

	  If you don't know what to do here, say N.
```

## drivers/xenpv_hvm/Kconfig
```kconfig
#
# This Kconfig describe xen options
#

# add other arch's if needed in depends below ...

menu "Xen PV-ON-HVM Configuration"

config XEN_PV_ON_HVM
# when/if ia64 xen-hfiles added to rhel4 sources
#	depends on !XEN && (X86_64 || X86 || IA64)
	bool "XEN_PV_ON_HVM Support"
	default y if (!X86_XEN && (X86 || X86_64))
	help
	  Support for Xen paravirtualized drivers on fully-virtualized guest

config XEN_BLKDEV_FRONTEND
	tristate "Block-device frontend driver"
	depends on XEN_PV_ON_HVM
	default y
	help
	  The block-device frontend driver allows the kernel to access block
	  devices mounted within another guest OS. Unless you are building a
	  dedicated device-driver domain, or your master control domain
	  (domain 0), then you almost certainly want to say Y here.

config XEN_NETDEV_FRONTEND
	tristate "Network-device frontend driver"
	depends on XEN_PV_ON_HVM
	default y
	help
	  The network-device frontend driver allows the kernel to access
	  network interfaces within another guest OS. Unless you are building a
	  dedicated device-driver domain, or your master control domain
	  (domain 0), then you almost certainly want to say Y here.

endmenu

#config HAVE_ARCH_ALLOC_SKB
#	bool
#	default y

#config HAVE_ARCH_DEV_ALLOC_SKB
#	bool
#	default y
```

## net/tux/Kconfig
```kconfig
config TUX
	tristate "TUX: Threaded linUX application protocol accelerator layer"
	default y if INET=y
	select ZLIB_DEFLATE
	help
	  This is the TUX content-accelerator/server

menu "TUX options"
	depends on TUX

config TUX_EXTCGI
	bool "External CGI module"
	default y

config TUX_EXTENDED_LOG
	bool "extended TUX logging format"
	default n

config TUX_DEBUG
	bool "debug TUX"
	default n

endmenu
```

## net/wireless/Kconfig
```kconfig
config CFG80211
	tristate "Improved wireless configuration API"
	depends on RFKILL || !RFKILL
	select WIRELESS_COMPAT

config CFG80211_REG_DEBUG
	bool "cfg80211 regulatory debugging"
	depends on CFG80211
	default n
	---help---
	  You can enable this if you want to debug regulatory changes.

	  If unsure, say N.

config CFG80211_DEBUGFS
	bool "cfg80211 DebugFS entries"
	depends on CFG80211 && DEBUG_FS
	---help---
	  You can enable this if you want to debugfs entries for cfg80211.

	  If unsure, say N.

config WIRELESS_OLD_REGULATORY
	bool "Old wireless static regulatory definitions"
	default n
	---help---
	  This option enables the old static regulatory information
	  and uses it within the new framework. This option is available
	  for historical reasons and it is advised to leave it off.

	  For details see:

	  http://wireless.kernel.org/en/developers/Regulatory

	  Say N and if you say Y, please tell us why. The default is N.

config CFG80211_INTERNAL_REGDB
	bool "Statically compiled regulatory rules database"
	default n
	depends on CFG80211
	---help---
	  This option generates an internal data structure representing
	  the wireless regulatory rules described in net/wireless/db.txt
	  and includes code to query that database.  This is an alternative
	  to using CRDA for defining regulatory rules for the kernel.

	  For details see:

	  http://wireless.kernel.org/en/developers/Regulatory

	  Most distributions have a CRDA package.  So if unsure, say N.

config WIRELESS_EXT
	bool "Wireless extensions"
	default n
	---help---
	  This option enables the legacy wireless extensions
	  (wireless network interface configuration via ioctls.)

	  Wireless extensions will be replaced by cfg80211 and
	  will be required only by legacy drivers that implement
	  wireless extension handlers. This option does not
	  affect the wireless-extension backward compatibility
	  code in cfg80211.

	  Say N (if you can) unless you know you need wireless
	  extensions for external modules.

config WIRELESS_COMPAT
	tristate "Wireless kernel compatibility code"
	depends on RFKILL || !RFKILL
	depends on CFG80211 || !CFG80211
```
